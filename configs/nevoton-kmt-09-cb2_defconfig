## configs/nevoton-kmt-09-cb2_defconfig
```kconfig
BR2_arm=y
BR2_cortex_a7=y
BR2_ARM_FPU_NEON_VFPV4=y
BR2_TOOLCHAIN_EXTERNAL=y
BR2_TARGET_GENERIC_HOSTNAME="kmt-09"
BR2_TARGET_GENERIC_ISSUE="Welcome to kmt-09!"
BR2_TARGET_GENERIC_GETTY_PORT="ttyS0"
BR2_ROOTFS_POST_BUILD_SCRIPT="board/cubietech/cubieboard2/post-build.sh"
BR2_ROOTFS_POST_IMAGE_SCRIPT="board/cubietech/cubieboard2/post-image.sh"
BR2_LINUX_KERNEL=y
BR2_LINUX_KERNEL_CUSTOM_VERSION=y
BR2_LINUX_KERNEL_CUSTOM_VERSION_VALUE="4.4.14"
BR2_LINUX_KERNEL_PATCH="board/nevoton/kmt-09/patches/linux"
BR2_LINUX_KERNEL_DEFCONFIG="sunxi"
BR2_LINUX_KERNEL_DTS_SUPPORT=y
BR2_LINUX_KERNEL_INTREE_DTS_NAME="sun7i-a20-cubieboard2"
BR2_PACKAGE_QT=y
BR2_PACKAGE_QT_LICENSE_APPROVED=y
BR2_PACKAGE_QT_FONT_UNIFONT=y
BR2_PACKAGE_QT_QTFREETYPE=y
BR2_PACKAGE_QT_QTPNG=y
BR2_PACKAGE_QT_GFX_VNC=y
BR2_PACKAGE_QT_KEYBOARD_TTY=y
BR2_PACKAGE_QT_SVG=y
BR2_PACKAGE_OPENSSH=y
BR2_PACKAGE_PROFTPD=y
BR2_TARGET_ROOTFS_EXT2=y
BR2_TARGET_ROOTFS_EXT2_4=y
BR2_TARGET_UBOOT=y
BR2_TARGET_UBOOT_BUILD_SYSTEM_KCONFIG=y
BR2_TARGET_UBOOT_CUSTOM_VERSION=y
BR2_TARGET_UBOOT_CUSTOM_VERSION_VALUE="2016.05"
BR2_TARGET_UBOOT_PATCH="board/nevoton/kmt-09/patches/uboot"
BR2_TARGET_UBOOT_BOARD_DEFCONFIG="Cubieboard2"
BR2_TARGET_UBOOT_NEEDS_DTC=y
BR2_TARGET_UBOOT_SPL=y
BR2_TARGET_UBOOT_SPL_NAME="u-boot-sunxi-with-spl.bin"
BR2_PACKAGE_HOST_DOSFSTOOLS=y
BR2_PACKAGE_HOST_GENIMAGE=y
BR2_PACKAGE_HOST_MTOOLS=y
BR2_PACKAGE_HOST_UBOOT_TOOLS=y
```

## configs/snps_archs38_hsdk_defconfig
```kconfig
# Architecture
BR2_arcle=y
BR2_archs38=y

# Linux headers same as kernel, a 4.19 series
BR2_PACKAGE_HOST_LINUX_HEADERS_CUSTOM_4_19=y

# System
BR2_TARGET_GENERIC_HOSTNAME="hsdk"
BR2_TARGET_GENERIC_ISSUE="Welcome to the HSDK Platform"
BR2_SYSTEM_DHCP="eth0"

# Kernel
BR2_LINUX_KERNEL=y
BR2_LINUX_KERNEL_CUSTOM_VERSION=y
BR2_LINUX_KERNEL_CUSTOM_VERSION_VALUE="4.19.31"
BR2_LINUX_KERNEL_DEFCONFIG="hsdk"
BR2_LINUX_KERNEL_CONFIG_FRAGMENT_FILES="board/synopsys/hsdk/linux.fragment"
BR2_LINUX_KERNEL_PATCH="board/synopsys/hsdk/patches/linux"
BR2_LINUX_KERNEL_VMLINUX=y

# Filesystem / image
BR2_TARGET_ROOTFS_INITRAMFS=y
```

## configs/snps_archs38_nsim_defconfig
```kconfig
BR2_arcle=y
BR2_archs38=y
BR2_ENABLE_DEBUG=y
BR2_TOOLCHAIN_BUILDROOT_GLIBC=y
BR2_KERNEL_HEADERS_4_17=y
BR2_INIT_SYSTEMD=y
BR2_LINUX_KERNEL=y
BR2_LINUX_KERNEL_CUSTOM_VERSION=y
BR2_LINUX_KERNEL_CUSTOM_VERSION_VALUE="4.18.10"
BR2_LINUX_KERNEL_DEFCONFIG="nsim_hs"
BR2_LINUX_KERNEL_VMLINUX=y
BR2_TARGET_ROOTFS_INITRAMFS=y
```

## configs/snps_rootfs_arc700_defconfig
```kconfig
BR2_arcle=y
BR2_KERNEL_HEADERS_4_8=y
BR2_TOOLCHAIN_BUILDROOT_INET_RPC=y
BR2_TOOLCHAIN_BUILDROOT_LOCALE=y
BR2_SYSTEM_DHCP="eth0"
BR2_ROOTFS_OVERLAY="board/synopsys/generic/fs-overlay"
BR2_ROOTFS_POST_IMAGE_SCRIPT="board/synopsys/generic/post-image.sh"
BR2_LINUX_KERNEL=y
BR2_LINUX_KERNEL_DEFCONFIG="nsim_700"
BR2_LINUX_KERNEL_VMLINUX=y
BR2_PACKAGE_LINUX_TOOLS_PERF=y
BR2_PACKAGE_RT_TESTS=y
BR2_PACKAGE_FB_TEST_APP=y
BR2_TARGET_ROOTFS_INITRAMFS=y
```

## configs/snps_rootfs_archs38_defconfig
```kconfig
BR2_arcle=y
BR2_archs38=y
BR2_TOOLCHAIN_BUILDROOT_LOCALE=y
BR2_SYSTEM_DHCP="eth0"
BR2_ROOTFS_POST_IMAGE_SCRIPT="board/synopsys/generic/post-image.sh"

# Default set of packages
BR2_PACKAGE_IPERF3=y
BR2_PACKAGE_RT_TESTS=y
BR2_PACKAGE_FB_TEST_APP=y

# This is required to make sure /init gets installed in "target",
# otherwise devtmpfs won't be auto-mounted
BR2_TARGET_ROOTFS_CPIO=y
```

## package/hackrf-host/Config.in
```kconfig
config BR2_PACKAGE_HACKRF_HOST
	bool "hackrf-host"
	select BR2_PACKAGE_LIBUSB
	depends on !BR2_STATIC_LIBS
	depends on BR2_INSTALL_LIBSTDCPP
	depends on BR2_TOOLCHAIN_HAS_THREADS
	depends on BR2_PACKAGE_FFTW_PRECISION_SINGLE
	help
	  Library and tools for accessing HackRF SDR boards.

	  https://github.com/mossmann/hackrf/tree/master/host

comment "hackrf-host needs a toolchain w/ C++, threads, dynamic library and fftw3f"
	depends on BR2_STATIC_LIBS
	depends on !BR2_INSTALL_LIBSTDCPP
	depends on !BR2_TOOLCHAIN_HAS_THREADS
	depends on !BR2_PACKAGE_FFTW_PRECISION_SINGLE
```
